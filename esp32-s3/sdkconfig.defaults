## esp32-s3/sdkconfig.defaults
```kconfig
CONFIG_ESPTOOLPY_FLASHSIZE_16MB=y
CONFIG_PARTITION_TABLE_CUSTOM=y
CONFIG_PARTITION_TABLE_CUSTOM_FILENAME="partitions_16MB.csv"

# FreeRTOS timer task needs more stack for PowerManager -> DisplayManager SPI calls
CONFIG_FREERTOS_TIMER_TASK_STACK_DEPTH=4096
```
